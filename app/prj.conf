## CMakeLists.txt
```
# SPDX-License-Identifier: Apache-2.0

set(BOARD mimxrt1060_evk)

cmake_minimum_required(VERSION 3.20.0)

find_package(Zephyr REQUIRED HINTS $ENV{ZEPHYR_BASE})
project(embsys330_final_project_app)

target_sources(app PRIVATE src/counter.c)
target_sources(app PRIVATE src/images.c)
target_sources(app PRIVATE src/main.c)
```

## prj.conf
```kconfig
CONFIG_LV_Z_MEM_POOL_SIZE=32768
CONFIG_LV_Z_SHELL=y
CONFIG_MAIN_STACK_SIZE=4096
CONFIG_DISPLAY=y
CONFIG_DISPLAY_MCUX_ELCDIF=y
CONFIG_DISPLAY_LOG_LEVEL_ERR=y
CONFIG_LV_Z_POINTER_KSCAN=y

CONFIG_LOG=y
CONFIG_SHELL=y

CONFIG_LVGL=y
CONFIG_LV_MEM_CUSTOM=y
CONFIG_LV_USE_LOG=y
CONFIG_LV_USE_LABEL=y
CONFIG_LV_USE_BTN=y
CONFIG_LV_USE_ARC=y
CONFIG_LV_USE_IMG=y
CONFIG_LV_USE_MONKEY=y
CONFIG_LV_FONT_MONTSERRAT_14=y

# Enable thread awareness for debugging tools supporting it
CONFIG_DEBUG_THREAD_INFO=y

# enabdfsdle to use thread names
CONFIG_THREAD_NAME=y
CONFIG_PWM=y
#Sensors for project
CONFIG_SENSOR=y
CONFIG_LPS22HB=y
CONFIG_HTS221=y
#shell commands
CONFIG_SHELL=y

# Enable polling used by the event mechanism
CONFIG_POLL=y

# Enable the state machine framework
CONFIG_SMF=y
CONFIG_SMF_ANCESTOR_SUPPORT=y
CONFIG_SMF_INITIAL_TRANSITION=y

#RTC module
CONFIG_RTC=y
#Config ADC
CONFIG_ADC=y
#CONFIG the GPIO
CONFIG_GPIO=y

CONFIG_I2C=y
```

## src/counter.c
```c
/**
 * Simple module for incrementing a global counter.
 * Primarily to demonstrate Ztest
*/

#include "counter.h"

static volatile uint32_t counter;

void counter_reset(void) {
        counter = 0;
}

void counter_increment(void) {
        counter++;
}

uint32_t counter_value(void) { 
        return counter;
}
```

## src/counter.h
```c
#pragma once

#include <stdint.h>

void counter_reset(void);
void counter_increment(void);
uint32_t counter_value(void);
```

## src/images.c
```c
#include "img_clothes.h"
#include "img_demo_widgets_avatar.h"
```

## src/lvgl.h
```c
/**
 * @file lv_demo_widgets.h
 *
 */

#ifndef LV_DEMO_WIDGETS_H
#define LV_DEMO_WIDGETS_H

#ifdef __cplusplus
extern "C" {
#endif

/*********************
 *      INCLUDES
 *********************/
#include "../lv_demos.h"

/*********************
 *      DEFINES
 *********************/

/**********************
 *      TYPEDEFS
 **********************/

/**********************
 * GLOBAL PROTOTYPES
 **********************/
void lv_demo_widgets(void);
void lv_demo_widgets_close(void);

/**********************
 *      MACROS
 **********************/

#ifdef __cplusplus
} /* extern "C" */
#endif

#endif /*LV_DEMO_WIDGETS_H*/
```
